# CC2340R5 register map
File version: 1.0
CC2340R5 SimpleLink(TM) Bluetooth(R) 5.2 Low Energy Wireless MCU
CPU: CM0P 1.0, other endian, MPU, FPU, 3 interrupt priority bits
Registers are 32-bit, read-write, reset 0x0 unless marked. A register's access mark holds for its fields unless they carry their own. Offsets are from the block's base; lines under a group give offsets from that group; [hi:lo] are bit positions; {n}, {i} and the like mark numbered series; 'fields as' and 'values as' point back to an identical list; <NAME> marks a mode.

## Memory map
0x00000000 FLASH_MAIN size 0x80000
0x0F000000 ROM size 0x3000
0x20000000 SRAM size 0x9000
0x40000000 PMCTL size 0x1000 — This component is the Power Management controller. Together with the System Controller, it controls system resets and the power states of the device.
0x40001000 CKMD size 0x1000 — Clock Controller
0x40002000 RTC size 0x1000 — ULL Real Time Clock module RTC includes 2 channels. - Channel 0 is a compare channel - Channel 1 is a capture channel
0x40003000 IOC size 0x1000 — ULL IOC
0x40004000 SYS0 size 0x1000 — This is top module of SYS0 for LOKI
0x40005000 EVTULL size 0x1000 — This is top module of ULL Event Fabric
0x40006000 PMUD size 0x1000
0x4000F000 DBGSS size 0x1000
0x40020000 CLKCTL size 0x1000 — This component is the clock controller. Here SW can turn on and off IP clocks and read IP and system clock status.
0x40021000 FLASH size 0x1000
0x40022000 SYSTIM size 0x1000 — SVT System Timer Module
0x40023000 GPIO size 0x1000 — MCU GPIO - I/F for controlling and reading IO status and IO event status
0x40024000 VIMS size 0x1000 — Loki VIMS module toplevel
0x40025000 EVTSVT size 0x1000 — This is top module of SVT Event Fabric
0x40026000 DMA size 0x1000 — ARM Micro Direct Memory Access Controller
0x40030000 SPI0 size 0x1000 — Serial Peripheral Interface (SPI) module with peripheral and controller capabilities.
0x40034000 UART0 size 0x1000 — Universal Asynchronous Receiver/Transmitter (UART) interface
0x40038000 I2C0 size 0x1000 — I2C IP
0x40050000 ADC size 0x1000 — ADC (Analog to Digital Converter) module
0x40060000 LGPT0 size 0x1000 — This component is a general purpose timer. The timer offers - generation of waveforms and events. - capture of signal period and duty cycle. - generation of IR signals. - decoding of quadrature encoded signals. - motor control features. It consists of a - 16-bit counter. - 8-bit prescaler - 3 capture compare channels. - 3 event outputs. - 3 capture inputs. Each channel subscribes to the synchronous event bus. They can control one or more event outputs in both capture and compare modes. PRECFG.TICKSRC selects tick source for the timer.
0x40061000 LGPT1 size 0x1000 — This component is a general purpose timer. The timer offers - generation of waveforms and events. - capture of signal period and duty cycle. - generation of IR signals. - decoding of quadrature encoded signals. - motor control features. It consists of a - 16-bit counter. - 8-bit prescaler - 3 capture compare channels. - 3 event outputs. - 3 capture inputs. Each channel subscribes to the synchronous event bus. They can control one or more event outputs in both capture and compare modes. PRECFG.TICKSRC selects tick source for the timer.
0x40062000 LGPT2 size 0x1000 — This component is a general purpose timer. The timer offers - generation of waveforms and events. - capture of signal period and duty cycle. - generation of IR signals. - decoding of quadrature encoded signals. - motor control features. It consists of a - 16-bit counter. - 8-bit prescaler - 3 capture compare channels. - 3 event outputs. - 3 capture inputs. Each channel subscribes to the synchronous event bus. They can control one or more event outputs in both capture and compare modes. PRECFG.TICKSRC selects tick source for the timer.
0x40063000 LGPT3 size 0x1000 — This component is a general purpose timer. The timer offers - generation of waveforms and events. - capture of signal period and duty cycle. - generation of IR signals. - decoding of quadrature encoded signals. - motor control features. It consists of a - 16-bit counter. - 8-bit prescaler - 3 capture compare channels. - 3 event outputs. - 3 capture inputs. Each channel subscribes to the synchronous event bus. They can control one or more event outputs in both capture and compare modes. PRECFG.TICKSRC selects tick source for the timer.
0x40080000 LRFDDBELL size 0x1000
0x40081800 LRFDTXF size 0x400
0x40081C00 LRFDRXF size 0x400
0x40090000 LRFD_PBERAM size 0x1000
0x40092000 LRFD_BUFRAM size 0x600
0x40094000 LRFD_MCERAM size 0x800
0x40096000 LRFD_RFERAM size 0x1000
0x400C0000 AES size 0x1000 — The AES-128 crypto peripheral accellerates AES-128 block cipher encryption (ECB). The peripheral does also offer hardware features to accellerate cipher modes implemented in software: * CBC-MAC * CBC * CTR * CFB * OFB * PCBC The module provides two data registers that can be input to ECB encryption. These are termed TXT and BUF. TXT is the AES-128 work buffer, and content changes during an ECB encryption. Software cannot update TXT during encryption. BUF is an auxiliary 128-bit buffer with multiple purposes: * initialization vector(IV) storage * counter in CTR cipher mode * hold next value of TXT Software can update BUF during an ECB enryption. This allows software to write next TXT during an encryption an hence save ECB idle times.
0x4E000000 FCFG size 0x400
0x4E020000 CCFG size 0x800
0xE0002000 BPU size 0x1000
0xE000E000 NVIC size 0x1000
0xE000E010 SYSTICK size 0x10
0xE000ED00 SCB size 0x40
0xE000ED30 DCB size 0x100
0xE000EFC0 SCSCS size 0x40
0xE00FF000 CPU_ROM_TABLE size 0x1000
