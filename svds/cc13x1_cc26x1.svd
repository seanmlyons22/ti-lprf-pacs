# CC1311P3 register map
File version: 1.0
SimpleLink(TM) multi-protocol CC1311P3 wireless MCU
CPU: CM4 1.0, other endian, MPU, FPU, 3 interrupt priority bits
Registers are 32-bit, read-write, reset 0x0 unless marked. A register's access mark holds for its fields unless they carry their own. Offsets are from the block's base; lines under a group give offsets from that group; [hi:lo] are bit positions; {n}, {i} and the like mark numbered series; 'fields as' and 'values as' point back to an identical list; <NAME> marks a mode.

## Memory map
0x40000000 SSI0 size 0x1000 — Synchronous Serial Interface with master and slave capabilities
0x40001000 UART0 size 0x1000 — Universal Asynchronous Receiver/Transmitter (UART) interface
0x40002000 I2C0 size 0x1000 — I2CMaster/Slave Serial Controler
0x40010000 GPT0 size 0x1000 — General Purpose Timer.
0x40011000 GPT1 size 0x1000 — General Purpose Timer.
0x40012000 GPT2 size 0x1000 — General Purpose Timer.
0x40013000 GPT3 size 0x1000 — General Purpose Timer.
0x40020000 UDMA0 size 0x1000 — ARM Micro Direct Memory Access Controller
0x40021000 I2S0 size 0x1000 — I2S Audio DMA module supporting formats I2S, LJF, RJF and DSP
0x40022000 GPIO size 0x400 — MCU GPIO - I/F for controlling and reading IO status and IO event status
0x40024000 CRYPTO size 0x800 — Crypto core with DMA capability and local key storage
0x40028000 TRNG size 0x2000 — True Random Number Generator
0x40030000 FLASH size 0x4000 — Flash sub-system registers, includes the Flash Memory Controller (FMC), flash read path, and an integrated Efuse controller and EFUSEROM.
0x40034000 VIMS size 0x400 — Versatile Instruction Memory System Controls memory access to the Flash and encapsulates the following instruction memories: - Boot ROM - Cache / GPRAM
0x40040000 RFC_PWR size 0x4 — RF core power management This module contains clock control for all RF core sub-modules.
0x40041000 RFC_DBELL size 0x40 — RF core doorbell The doorbell module is the main user interface to the radio sub-system. It contains the registers used for both submitting commands to the radio, and for configuring radio interrupts from the RF core.
0x40043000 RFC_RAT size 0x100 — RF core radio timer
0x40080000 WDT size 0x1000 — Watchdog Timer
0x40081000 IOC size 0x1000 — IO Controller (IOC) - configures all the DIOs and resides in the MCU domain. Note: Performing a write operation that includes IOC.IOCFGn.PORT_ID, may cause glitches on the IO. This can happen even if the write operation does not actually change the PORT_ID field (i.e. the write operation writes the same value as it already held) . This happens because the write operation triggers activities in the IOC that may, in some cases, cause glitches. To avoid glitches refrain from writing to this field other than when needed to actually change the PORT_ID value. Note that it is possible to write to parts of the IOCFGn register without writing to PORT_ID by using byte oriented writes to the parts of the register that do not contain PORT_ID.
0x40082000 PRCM size 0x1000 — Power, Reset and Clock Management
0x40083000 EVENT size 0x1000 — Event Fabric Component Definition
0x40084000 SMPH size 0x1000 — MCU Semaphore Module This module provides 32 binary semaphores. The state of a binary semaphore is either taken or available. A semaphore does not implement any ownership attribute. Still, a semaphore can be used to handle mutual exclusion scenarios.
0x40090000 AON_PMCTL size 0x1000 — This component control the Power Management controller residing in the AON domain. Note: This module is only supporting 32 bit Read Write access from MCU
0x40092000 AON_RTC size 0x400 — This component control the Real Time Clock residing in AON Note: This module is only supporting 32 bit ReadWrite access.
0x40093000 AON_EVENT size 0x400 — This module configures the event fabric located in the AON domain. Note: This module is only supporting 32 bit ReadWrite access from MCU
0x40094000 AON_IOC size 0x400 — Always On (AON) IO Controller - controls IO operation when the MCU IO Controller (IOC) is powered off and resides in the AON domain. Note: This module only supports 32 bit Read/Write access from MCU.
0x40095000 AON_BATMON size 0x400 — Always On (AON) Battery And Temperature MONitor (BATMON) residing in the AON domain Note: This module only supports 32 bit Read/Write access from MCU.
0x400C4000 AUX_TDC size 0x1000 — AUX Time To Digital Converter (AUX_TDC) is used to measure the time between two events with high resolution. AUX_TDC consists of a state machine that operates at AUX bus rate and an asynchronous fast-counter which is clocked by the TDC clock. DDI_0_OSC:CTL0.ACLK_TDC_SRC_SEL configures TDC clock source. The fast-counter counts on both edges of the TDC clock to double the resolution. See the Technical Reference Manual for event timing requirements.
0x400C5000 AUX_EVCTL size 0x1000 — AUX Event Controller (AUX_EVCTL) assembles events originating from: - AUX submodules, including ADC and comparators. - AUXIO. - EVENT. - AON_PMCTL. - AON_RTC. into two 64-bit event buses. One is synchronized to the AUX clock and one is left unsynchronized. The subscribers to the synchronous event bus are AUX_TIMER01 and AUX_EVCTL. The subscribers to the asynchronous event bus are AUX_ANAIF, AUX_TDC and AUX_SYSIF. AUX_EVCTL uses the synchronous event bus to generate events to AON_EVENT and EVENT.
0x400C6000 AUX_SYSIF size 0x1000 — AUX System Interface (AUX_SYSIF) is responsible for: - system resource requests, such as power supply and clock requests. - configuration of AUX peripheral operational rates for AUX_ANAIF DAC state machine and AUX_TIMER01. - configuration of event synchronization rate for AUX_EVCTL:EVSTAT2 and AUX_EVCTL:EVSTAT3. Peripheral operational rate for AUX modules mentioned above can either be: - SCE rate, which is configured in AON_PMCTL:AUXSCECLK. - AUX bus rate, which equals SCE rate or SCLK_HF divided by two when MCU domain is active or AUX operational mode is active. AUX_SYSIF also interfaces AON_RTC to enable read access to data and sub-second increment control of AON_RTC.
0x400C7000 AUX_TIMER01 size 0x1000 — AUX Timer 0 and AUX Timer 1 (AUX_TIMER01) are two 16-bit timers capable of generating one event each: - AUX_EVCTL:EVSTAT3.AUX_TIMER0_EV. - AUX_EVCTL:EVSTAT3.AUX_TIMER1_EV. The events are described in T0TARGET and T1TARGET. Subscribers to the AUX event bus can use these events to sequence and trigger actions. AUX_SYSIF:PEROPRATE.TIMER01_OP_RATE sets the peripheral clock frequency used by the prescaler, timer, and event logic to SCE or AUX bus rate. To use AUX_TIMER01: - System CPU must set AUX_SYSIF:PEROPRATE.TIMER01_OP_RATE to SCE_RATE if event subscriber works on SCE_RATE. - System CPU must set AUX_SYSIF:PEROPRATE.TIMER01_OP_RATE to BUS_RATE. - The timers must only subscribe to events updated at the peripheral clock frequency or lower. Unexpected execution behavior can result if software does not obey these rules.
0x400C8000 AUX_SMPH size 0x1000 — AUX Semaphore (AUX_SMPH) provides hardware means to share modules in AUX safely between CPUs based on resource ownership. AUX_SMPH operates at AUX bus rate.
0x400C9000 AUX_ANAIF size 0x1000 — AUX Analog Interface (AUX_ANAIF) encapsulates direct data and control interfaces between AUX digital and AUX analog circuits. It lets UDMA0, and system CPU: -Trigger ADC sample and conversion process. - Write ADC samples to FIFO. - Charge analog nodes by the use of the analog ISRC module. See ADI_4_AUX:ISRC and ADI_4_AUX:COMP.COMPA_REF_CURR_EN for further information. - Use the DAC to generate a programmable voltage on COMPB_REF, COMPA_REF, or COMPA_IN analog nodes. To use: - DAC : System CPU must set AUX_SYSIF:PEROPRATE.ANAIF_DAC_OP_RATE to BUS_RATE as long as DAC state machine generates the sample clock. See DACSMPLCTL.EN for further information.
0x400CA000 AUX_DDI0_OSC size 0x1000 — This is the DDI for the digital block that controls all the analog clock oscillators (OSC_DIG) and performs qualification of the clocks generated.
0x400CB000 AUX_ADI4 size 0x200 — Configuration registers controlling analog peripherals of AUX. Registers Fields should be considered static unless otherwise noted (as dynamic)
0x400CC000 AUX_AIODIO0 size 0x1000 — AUX Analog Digital Input Output Controller (AUX_AIODIO) controls the general purpose input output pins of the AUX domain. These pins are referenced as AUXIO and can: - be connected to analog AUX modules, such as comparators and ADC. - connect to the asynchronous AUX event bus. Enabled digital inputs are synchronized at SCE clock rate. Note that the IO mapping in the AUX domain is different from the IO mapping in the MCU domain. This means that AUXIO[n] does not map to DIO[n].
0x400CD000 AUX_AIODIO1 size 0x1000 — AUX Analog Digital Input Output Controller (AUX_AIODIO) controls the general purpose input output pins of the AUX domain. These pins are referenced as AUXIO and can: - be connected to analog AUX modules, such as comparators and ADC. - connect to the asynchronous AUX event bus. Enabled digital inputs are synchronized at SCE clock rate. Note that the IO mapping in the AUX domain is different from the IO mapping in the MCU domain. This means that AUXIO[n] does not map to DIO[n].
0x400CE000 AUX_AIODIO2 size 0x1000 — AUX Analog Digital Input Output Controller (AUX_AIODIO) controls the general purpose input output pins of the AUX domain. These pins are referenced as AUXIO and can: - be connected to analog AUX modules, such as comparators and ADC. - connect to the asynchronous AUX event bus. Enabled digital inputs are synchronized at SCE clock rate. Note that the IO mapping in the AUX domain is different from the IO mapping in the MCU domain. This means that AUXIO[n] does not map to DIO[n].
0x400CF000 AUX_AIODIO3 size 0x1000 — AUX Analog Digital Input Output Controller (AUX_AIODIO) controls the general purpose input output pins of the AUX domain. These pins are referenced as AUXIO and can: - be connected to analog AUX modules, such as comparators and ADC. - connect to the asynchronous AUX event bus. Enabled digital inputs are synchronized at SCE clock rate. Note that the IO mapping in the AUX domain is different from the IO mapping in the MCU domain. This means that AUXIO[n] does not map to DIO[n].
0x50001000 FCFG1 size 0x800 — Factory configuration area (FCFG1)
0xE0000000 CPU_ITM size 0x1000 — Cortex-M's Instrumentation Trace Macrocell (ITM)
0xE0001000 CPU_DWT size 0x1000 — Cortex-M's Data watchpoint and Trace (DWT)
0xE0002000 CPU_FPB size 0x1000 — Cortex-M's Flash Patch and Breakpoint (FPB)
0xE000E000 CPU_SCS size 0x1000 — Cortex-M's System Control Space (SCS)
0xE0040000 CPU_TPIU size 0x1000 — Cortex-M's Trace Port Interface Unit (TPIU)
0xE00FE000 CPU_TIPROP size 0x1000 — Cortex-M's TI proprietary registers
